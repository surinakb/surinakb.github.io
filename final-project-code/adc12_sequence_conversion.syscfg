/**
 * @cliArgs --device "MSPM0G350X" --part "Default" --package "LQFP-64(PM)" --product "mspm0_sdk@2.04.00.06"
 * @versions {"tool":"1.22.0+3893"}
 */

/**
 * Import the modules used in this configuration.
 */
const ADC12  = scripting.addModule("/ti/driverlib/ADC12", {}, false);
const ADC121 = ADC12.addInstance();
const Board  = scripting.addModule("/ti/driverlib/Board");
const SYSCTL = scripting.addModule("/ti/driverlib/SYSCTL");

/**
 * Write custom configuration values to the imported modules.
 */
ADC121.$name                 = "ADC12_0";
ADC121.sampClkSrc            = "DL_ADC12_CLOCK_ULPCLK";
ADC121.sampClkDiv            = "DL_ADC12_CLOCK_DIVIDE_8";
ADC121.powerDownMode         = "DL_ADC12_POWER_DOWN_MODE_MANUAL";
ADC121.samplingOperationMode = "sequence";
ADC121.sampleTime0           = "40 us";
ADC121.endAdd                = 5;
ADC121.adcMem2chansel        = "DL_ADC12_INPUT_CHAN_2";
ADC121.adcMem3chansel        = "DL_ADC12_INPUT_CHAN_3";
ADC121.adcMem4chansel        = "DL_ADC12_INPUT_CHAN_4";
ADC121.adcMem5chansel        = "DL_ADC12_INPUT_CHAN_12";
ADC121.adcMem1chansel        = "DL_ADC12_INPUT_CHAN_7";
ADC121.enabledInterrupts     = ["DL_ADC12_INTERRUPT_MEM5_RESULT_LOADED"];
ADC121.peripheral.$assign    = "ADC0";
ADC121.adcPin0Config.$name   = "ti_driverlib_gpio_GPIOPinGeneric2";
ADC121.adcPin2Config.$name   = "ti_driverlib_gpio_GPIOPinGeneric1";
ADC121.adcPin3Config.$name   = "ti_driverlib_gpio_GPIOPinGeneric3";
ADC121.adcPin4Config.$name   = "ti_driverlib_gpio_GPIOPinGeneric0";
ADC121.adcPin12Config.$name  = "ti_driverlib_gpio_GPIOPinGeneric4";
ADC121.adcPin7Config.$name   = "ti_driverlib_gpio_GPIOPinGeneric5";


SYSCTL.forceDefaultClkConfig = true;

/**
 * Pinmux solution for unlocked pins/peripherals. This ensures that minor changes to the automatic solver in a future
 * version of the tool will not impact the pinmux you originally saw.  These lines can be completely deleted in order to
 * re-solve from scratch.
 */
ADC121.peripheral.adcPin0.$suggestSolution  = "PA27";
ADC121.peripheral.adcPin2.$suggestSolution  = "PA25";
ADC121.peripheral.adcPin3.$suggestSolution  = "PA24";
ADC121.peripheral.adcPin4.$suggestSolution  = "PB25";
ADC121.peripheral.adcPin12.$suggestSolution = "PA14";
ADC121.peripheral.adcPin7.$suggestSolution  = "PA22";
Board.peripheral.$suggestSolution           = "DEBUGSS";
Board.peripheral.swclkPin.$suggestSolution  = "PA20";
Board.peripheral.swdioPin.$suggestSolution  = "PA19";
SYSCTL.peripheral.$suggestSolution          = "SYSCTL";
